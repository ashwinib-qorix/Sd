AUTOSAR XML (schema 00053)
standard types defined: uint8
package /AUTOSAR_SD/BswModuleDescriptions
  bsw module description Sd: module-id=171
    provided-entrys:
      Sd_Init
      Sd_GetVersionInfo
      Sd_ServerServiceSetState
      Sd_ClientServiceSetState
      Sd_ConsumedEventGroupSetState
      Sd_LocalIpAddrAssignmentChg
      Sd_MainFunction
    bsw internal behavior Sd_IB
      exclusive area MODE_STATUS_PROTECTION
      bsw schedulable entity Sd_MainFunction_SE: can-enter-exclusive-area=MODE_STATUS_PROTECTION, implemented-entry=Sd_MainFunction
      bsw timing event Sd_MainFunction_TE: starts-on-event=Sd_MainFunction_SE, period=0.01
package /AUTOSAR_SD/BswModuleEntrys
  8 x bsw module entry, all with sw-service-impl-policy=STANDARD:
    Sd_Init: service-id=1, is-reentrant=false, is-synchronous=true, call-type=REGULAR, execution-context=UNSPECIFIED, bsw-entry-kind=ABSTRACT
      sw service arg ConfigPtr: direction=IN
    Sd_GetVersionInfo: service-id=2, is-reentrant=true, is-synchronous=true, call-type=REGULAR, execution-context=UNSPECIFIED
      sw service arg versioninfo: direction=OUT
    Sd_ServerServiceSetState: service-id=7, is-reentrant=true, is-synchronous=false, call-type=REGULAR, execution-context=UNSPECIFIED
      sw service arg SdServerServiceHandleId: direction=IN
      sw service arg ServerServiceState: direction=IN, implementation-data-type=Sd_ServerServiceSetStateType
    Sd_ClientServiceSetState: service-id=8, is-reentrant=true, is-synchronous=false, call-type=REGULAR, execution-context=UNSPECIFIED
      sw service arg ClientServiceHandleId: direction=IN
      sw service arg ClientServiceState: direction=IN, implementation-data-type=Sd_ClientServiceSetStateType
    Sd_ConsumedEventGroupSetState: service-id=9, is-reentrant=true, is-synchronous=false, call-type=REGULAR, execution-context=UNSPECIFIED
      sw service arg SdConsumedEventGroupHandleId: direction=IN
      sw service arg ConsumedEventGroupState: direction=IN, implementation-data-type=Sd_ConsumedEventGroupCurrentStateType
    Sd_LocalIpAddrAssignmentChg: service-id=5, is-reentrant=true, is-synchronous=true, call-type=REGULAR, execution-context=UNSPECIFIED
      sw service arg SoConId: direction=IN
      sw service arg State: direction=IN
    Sd_RxIndication: service-id=66, is-reentrant=true, is-synchronous=true, call-type=CALLBACK, execution-context=UNSPECIFIED
      return type RxPduId: direction=IN
      sw service arg PduInfoPtr: direction=IN
    Sd_MainFunction: function-prototype-emitter=RTE, service-id=6, is-reentrant=false, is-synchronous=true, call-type=SCHEDULED, execution-context=TASK
package /AUTOSAR_SD/BswImplementations
  bsw implementation Sd_Impl: programming-language=C, sw-version=0.3.0, vendor-id=39, ar-release-version=4.10.0, behavior=Sd_IB, vendor-specific-module-def=Sd
    code-descriptors:
      code Sd
        artifact-descriptors:
          short-label=Sd.c, category=SWSRC, domain=AUTOMOTIVE
          short-label=Sd.h, category=SWHDR, domain=AUTOMOTIVE
          short-label=Sd_cbk.c, category=SWSRC, domain=AUTOMOTIVE
          short-label=Sd_cbk.h, category=SWHDR, domain=AUTOMOTIVE
          short-label=Sd_Internal.h, category=SWHDR, domain=AUTOMOTIVE
          short-label=Sd_Internal.c, category=SWSRC, domain=AUTOMOTIVE
          short-label=Sd_Rx.c, category=SWSRC, domain=AUTOMOTIVE
          short-label=Sd_State.c, category=SWSRC, domain=AUTOMOTIVE
          short-label=Sd_IntTypes.h, category=SWHDR, domain=AUTOMOTIVE
          short-label=Sd_Tx.c, category=SWSRC, domain=AUTOMOTIVE
          short-label=Sd_MemMap.h, category=SWHDR, domain=AUTOMOTIVE
          short-label=Sd_Version.c, category=SWSRC, domain=AUTOMOTIVE
          short-label=Sd_Version.h, category=SWHDR, domain=AUTOMOTIVE
    compiler ghs_Compiler: name=ghs_Compiler, options=cpu=ppc5748gz4204 -c -ansi -noSPE -Ospeed -sda=0 -vle -dual_debug -G --no_exceptions -Wundef -Wimplicit-int -Wshadow -Wtrigraphs --prototype_errors --incorrect_pragma_warnings -preprocess_assembly_files -nostartfile --short_enum -DGHS, vendor=Green Hills, version=6.1.0
    generated-artifacts:
      dependency on artifact Sd_MemMap: artifact-descriptor={short-label=Sd_MemMap.h, category=SWHDR, revision-labels=1.0.1, domain=AUTOMOTIVE}
      dependency on artifact KPIT: category=CODEGENERATOR, artifact-descriptor={short-label=C4K, category=CODEGENERATOR, revision-labels=23.1.X, domain=AUTOMOTIVE}, usages=CODEGENERATION
    linker ghs_Linker: name=ghs_Linker, options=-cpu=ppc5748gz4204 -nostartfiles -linker_warnings -vle, vendor=Green Hills, version=6.1.0
    resource consumption Sd_RC
      measured execution time Sd_MainFunction_MET
      measured heap usage Sd_MHU
      rough estimate heap usage Sd_REHU
      worst case heap usage Sd_WCHU
      24 x memory section, all with prefix=Sd:
        CONFIG_CONST_8: alignment=8, symbol=DATA
        CONFIG_CONST_UNSPECIFIED: alignment=UNSPECIFIED, symbol=DATA
        VAR_CLEARED_BOOLEAN: alignment=BOOLEAN, symbol=DATA
        VAR_NO_INIT_UNSPECIFIED: alignment=NO_INIT_UNSPECIFIED, symbol=DATA
        VAR_NO_INIT_16: alignment=16, symbol=DATA
        VAR_NO_INIT_32: alignment=32, symbol=DATA
        CODE: alignment=UNSPECIFIED
        VAR_NO_INIT_BOOLEAN: alignment=BOOLEAN, symbol=DATA
        VAR_NO_INIT_8: alignment=8, symbol=DATA
        VAR_INIT_BOOLEAN: alignment=BOOLEAN, symbol=DATA
        CONST_BOOLEAN: alignment=BOOLEAN, symbol=DATA
        VAR_CLEARED_8: alignment=8, symbol=DATA
        VAR_CLEARED_16: alignment=16, symbol=DATA
        VAR_CLEARED_32: alignment=32, symbol=DATA
        VAR_CLEARED_UNSPECIFIED: alignment=UNSPECIFIED, symbol=DATA
        VAR_INIT_8: alignment=8, symbol=DATA
        VAR_INIT_16: alignment=16, symbol=DATA
        VAR_INIT_32: alignment=32, symbol=DATA
        VAR_INIT_UNSPECIFIED: alignment=UNSPECIFIED, symbol=DATA
        CONST_BOOLEAN_UNSPECIFIED: alignment=UNSPECIFIED, symbol=DATA
        CONST_8: alignment=8, symbol=DATA
        CONST_16: alignment=16, symbol=DATA
        DBTOC_CONFIG_CONST_UNSPECIFIED: alignment=UNSPECIFIED, symbol=DATA
        CONST_UNSPECIFIED: alignment=UNSPECIFIED, symbol=DATA
      section name prefix Sd
      measured stack usage Sd_MainFunction_MSU
      rough estimate stack usage Sd_MainFunction_RESU
      worst case stack usage Sd_MainFunction_WCSU
package /AUTOSAR_SD/ImplementationDataTypes
  6 x impl type, all with category=VALUE, base-type=uint8, sw-impl-policy=CONST, type-emitter=Sd:
    Sd_ServerServiceSetStateType
    Sd_ClientServiceSetStateType
    Sd_ConsumedEventGroupSetStateType
    Sd_ClientServiceCurrentStateType
    Sd_ConsumedEventGroupCurrentStateType
    Sd_EventHandlerCurrentStateType
